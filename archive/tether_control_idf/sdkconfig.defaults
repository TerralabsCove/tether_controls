## archive/tether_control_idf/sdkconfig.defaults
```kconfig
CONFIG_IDF_TARGET="esp32c6"
CONFIG_ESP_CONSOLE_USB_SERIAL_JTAG=y
CONFIG_ESP_WIFI_ESPNOW_MAX_ENCRYPT_NUM=6
CONFIG_COMPILER_WARN_WRITE_STRINGS=y
```
